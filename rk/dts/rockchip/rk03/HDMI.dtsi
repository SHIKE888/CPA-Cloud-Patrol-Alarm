&hdmi {
	status = "okay";
	enable-gpios = <&gpio2 RK_PB0 GPIO_ACTIVE_HIGH>;
	rockchip,sda-falling-delay-ns = <360>;
};

&hdmi_in_vp0 {
	status = "okay";
};

&hdptxphy_hdmi {
	status = "okay";
};


&route_hdmi {
	status = "okay";
	connect = <&vp0_out_hdmi>;
};